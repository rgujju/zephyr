## CMakeLists.txt
```
# SPDX-License-Identifier: Apache-2.0

cmake_minimum_required(VERSION 3.13.1)

find_package(Zephyr REQUIRED HINTS $ENV{ZEPHYR_BASE})
project(lvgl)

FILE(GLOB app_sources src/*.c src/gui/*.c src/gui/fonts/*.c src/menu/*.c)
zephyr_include_directories(
    ${CMAKE_CURRENT_LIST_DIR}/src/
    )
target_sources(app PRIVATE ${app_sources})
```

## prj.conf
```kconfig
CONFIG_HEAP_MEM_POOL_SIZE=16384

CONFIG_LOG=y
#CONFIG_DISPLAY_LOG_LEVEL_DBG=y
CONFIG_LOG_BACKEND_SHOW_COLOR=n
CONFIG_SERIAL=y
CONFIG_UART_CONSOLE=y
CONFIG_UART_CONSOLE_ON_DEV_NAME="UART_0"
CONFIG_LOG_BUFFER_SIZE=4096
CONFIG_ASSERT=y

CONFIG_MAIN_STACK_SIZE=4096

CONFIG_DISPLAY=y

#CONFIG_LVGL_USE_DEBUG=y
CONFIG_LVGL_LOG_LEVEL_OFF=y
CONFIG_LVGL=y
CONFIG_LVGL_USE_ANIMATION=y

CONFIG_LVGL_USE_LIST=y
CONFIG_LVGL_USE_PAGE=y
CONFIG_LVGL_USE_LABEL=y
CONFIG_LVGL_USE_CONT=y
CONFIG_LVGL_USE_BTN=y
CONFIG_LVGL_USE_GROUP=y
CONFIG_LVGL_FONT_MONTSERRAT_18=y
```

## boards/native_posix_64.conf
```kconfig
CONFIG_SDL_DISPLAY_DEV_NAME="DISPLAY"
CONFIG_SDL_DISPLAY_X_RES=176
CONFIG_SDL_DISPLAY_Y_RES=176

CONFIG_KSCAN=y
CONFIG_LVGL_POINTER_KSCAN=y
CONFIG_LVGL_HOR_RES_MAX=176
CONFIG_LVGL_VER_RES_MAX=176
CONFIG_LVGL_DPI=100
```

## boards/nrf52840_kwp2.conf
```kconfig
CONFIG_DISPLAY=y

#LPM0XX:
#CONFIG_LPM0XX=y
#CONFIG_SPI=y
#CONFIG_LPM0XX_VCOM_DRIVER=y
#
## LVGL does not natively support 3 bit displays
## so color depth is kept at 8 bit RGB332 and then
## converted to 3 bit
#CONFIG_LVGL_COLOR_DEPTH_8=y
#CONFIG_LVGL_BITS_PER_PIXEL=4
#CONFIG_LVGL_EXTRA_BYTES=352
#CONFIG_LVGL_HOR_RES_MAX=176
#CONFIG_LVGL_VER_RES_MAX=176
#CONFIG_LVGL_DPI=100
## VDB size has to be 100% for LPM0XX display
## since the driver writes the line numbers in
## the buffer during init so that we save a lot of
## time during the actual SPI transfer
#CONFIG_LVGL_VDB_SIZE=100
#CONFIG_RATCH_LVGL_DRAW_RELATIVE=n


#LS0XX:
CONFIG_LS0XX=y
CONFIG_SPI=y

CONFIG_LVGL_COLOR_DEPTH_1=y
CONFIG_LVGL_BITS_PER_PIXEL=1
CONFIG_LVGL_EXTRA_BYTES=0
CONFIG_LVGL_HOR_RES_MAX=128
CONFIG_LVGL_VER_RES_MAX=128
CONFIG_LVGL_DPI=100

CONFIG_LVGL_VDB_SIZE=100
```

## src/main.c
```c
/*
 * Copyright (c) 2020 Rohit Gujarathi <gujju.rohit@gmail.com>
 *
 * SPDX-License-Identifier: Apache-2.0
 */

#include <zephyr.h>
#include <gui/gui.h>
#include <menu/menu.h>

#include <logging/log.h>
LOG_MODULE_REGISTER(app, 4);


//////////////////
// External items
/////////////////
#define APP_NAME_SIZE 20
struct app_db_entry {
	sys_snode_t node;
	char app_name[APP_NAME_SIZE];
	uint8_t uid;
	//tinf_t *tinf_base;
};

/** List of apps of struct app_db_entry */
static sys_slist_t app_list;

char *get_app_name(struct app_db_entry *app){
	return app->app_name;
}

uint8_t *get_app_uid(struct app_db_entry *app){
	return &app->uid;
}

sys_slist_t *get_app_list(){
	return &app_list;
}

char *apps[] = {"Settings",
				"Music",
				"Notifications",
				"Weather",
				"Reminders",
				"Battery",
				"Navigation",
				"About",

};

void init_external(){
	sys_slist_init(&app_list);
	
	for(uint8_t i = 0; i < sizeof(apps)/sizeof(char *); i++){
		struct app_db_entry *app = k_malloc(sizeof(struct app_db_entry));
		memcpy(app->app_name, apps[i], APP_NAME_SIZE);
		app->uid = i;
		sys_slist_append(&app_list, &app->node);
	}
}


void list_apps(void)
{
	sys_snode_t *node;
	ARG_UNUSED(node);
	struct app_db_entry *app;

	SYS_SLIST_FOR_EACH_CONTAINER(&app_list, app, node) {
		printk("app: %s\n", log_strdup(app->app_name));
		//LOG_INF("app");
	}
}

////////////////


void main(void)
{
	init_external();

	if(gui_init() < 0){
		return;
	}
	pagestack_push(&menu_setup, NULL, NULL);

	gui_loop();
}
```

## src/external.h
```c
#include <zephyr.h>
struct app_db_entry;
sys_slist_t *get_app_list();
char *get_app_name(struct app_db_entry *app);
uint8_t *get_app_uid(struct app_db_entry *app);
```
