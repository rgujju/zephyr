## drivers/display/Kconfig.lpm0xx
```kconfig
# JDisplay color memory display controller configuration options

# Copyright (c) 2020 Rohit Gujarathi
# SPDX-License-Identifier: Apache-2.0

config LPM0XX
	bool "LPM0XX memory display controller driver"
	depends on SPI
	help
	  Enable driver for Japan display color memory LCD

config LPM0XX_VCOM_DRIVER
	bool "VCOM toggling is handled by driver"
	depends on LPM0XX
	default y if LPM0XX
	help
	  VCOM will be toggled by driver based on extcomin-gpios defined
	  devicetree, else user has to handle toggling. If LPM0XX_VCOM_DRIVER=n and
	  using serial mode then user has to handle contention between
	  SPI transfers for write and VCOM toggle cmd.
```

## dts/bindings/display/jdisplay,lpm0xx.yaml
```yaml
# Copyright (c) 2020, Rohit Gujarathi
# SPDX-License-Identifier: Apache-2.0

description: Japan Display color memory display controller

compatible: "jdisplay,lpm0xx"

include: spi-device.yaml

properties:
    height:
      type: int
      required: true
      description: Height in pixel of the panel driven by the controller

    width:
      type: int
      required: true
      description: Width in pixel of the panel driven by the controller

    scs-gpios:
      type: phandle-array
      required: true
      description: SCS pin

        The SCS pin is the SPI chip select pin of sharp memory display.
        It is active high.

    extcomin-gpios:
      type: phandle-array
      required: false
      description: EXTCOMIN pin

        The EXTCOMIN pin is where a square pulse should be given
        If defined, toggle VCOM using this pin (EXTMODE connected to VDD)
        else from software by toggling the M1 bit (EXTMODE connected to VSS).

    disp-gpios:
      type: phandle-array
      required: false
      description: DISPLAY pin

        The DISPLAY pin controls if the LCD displays memory contents or
        blank screen. If defined, use display_blanking_off API to show
        memory contents.
```
